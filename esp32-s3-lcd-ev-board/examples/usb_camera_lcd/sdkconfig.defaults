## esp32-s3-lcd-ev-board/examples/usb_keyboard/sdkconfig.defaults
```kconfig
CONFIG_IDF_TARGET="esp32s3"
CONFIG_ESPTOOLPY_FLASHMODE_QIO=y
CONFIG_ESPTOOLPY_FLASHFREQ_120M=y
CONFIG_ESPTOOLPY_FLASHSIZE_8MB=y
CONFIG_LCD_EVB_SCREEN_FREQ=12
CONFIG_COMPILER_OPTIMIZATION_PERF=y
CONFIG_SPIRAM=y
CONFIG_SPIRAM_MODE_OCT=y
CONFIG_SPIRAM_FETCH_INSTRUCTIONS=y
CONFIG_SPIRAM_RODATA=y
CONFIG_SPIRAM_SPEED_120M=y
CONFIG_ESP_DEFAULT_CPU_FREQ_MHZ_240=y
CONFIG_ESP32S3_DATA_CACHE_64KB=y
CONFIG_ESP32S3_DATA_CACHE_LINE_64B=y
CONFIG_ESP_CONSOLE_USB_SERIAL_JTAG=y
CONFIG_ESP_IPC_TASK_STACK_SIZE=4096
CONFIG_FREERTOS_HZ=1000
CONFIG_TINYUSB=y
# CONFIG_TINYUSB_DESC_USE_ESPRESSIF_VID is not set
CONFIG_TINYUSB_DESC_CUSTOM_VID=0x303A
# CONFIG_TINYUSB_DESC_USE_DEFAULT_PID is not set
CONFIG_TINYUSB_DESC_CUSTOM_PID=0x3000
CONFIG_TINYUSB_HID_ENABLED=y
CONFIG_LV_MEM_CUSTOM=y
```

## esp32-s3-lcd-ev-board/examples/usb_msc_file_sys/sdkconfig.defaults
```kconfig
CONFIG_IDF_TARGET="esp32s3"
CONFIG_ESPTOOLPY_FLASHMODE_QIO=y
CONFIG_ESPTOOLPY_FLASHSIZE_16MB=y
CONFIG_PARTITION_TABLE_CUSTOM=y
CONFIG_COMPILER_OPTIMIZATION_PERF=y
CONFIG_SPIRAM=y
CONFIG_SPIRAM_MODE_OCT=y
CONFIG_SPIRAM_FETCH_INSTRUCTIONS=y
CONFIG_SPIRAM_RODATA=y
CONFIG_ESP_DEFAULT_CPU_FREQ_MHZ_240=y
CONFIG_FREERTOS_HZ=1000
CONFIG_LV_MEM_CUSTOM=y
CONFIG_LV_MEMCPY_MEMSET_STD=y
CONFIG_LV_USE_PERF_MONITOR=y
CONFIG_LV_FONT_MONTSERRAT_12=y
CONFIG_LV_FONT_MONTSERRAT_16=y
CONFIG_LV_FONT_MONTSERRAT_26=y
CONFIG_LV_USE_DEMO_WIDGETS=y
CONFIG_LV_USE_DEMO_BENCHMARK=y
CONFIG_LV_USE_DEMO_STRESS=y
CONFIG_LV_USE_DEMO_MUSIC=y
CONFIG_LV_DEMO_MUSIC_AUTO_PLAY=y
CONFIG_LV_USE_GIF=y
CONFIG_LV_USE_PNG=y
CONFIG_LV_USE_SJPG=y
# 83 == 'S'
CONFIG_LV_FS_POSIX_LETTER=83
CONFIG_LV_USE_BMP=y
CONFIG_LV_USE_FS_POSIX=y
CONFIG_LV_IMG_CACHE_DEF_SIZE=2

#
# FAT Filesystem support
#
CONFIG_FATFS_API_ENCODING_UTF_8=y
CONFIG_FATFS_LFN_HEAP=y

#
# Display
#
CONFIG_BSP_DISPLAY_LVGL_TASK_STACK_SIZE_KB=6
CONFIG_BSP_LCD_RGB_BUFFER_NUMS=2
CONFIG_BSP_LCD_RGB_BOUNCE_BUFFER_MODE=y
CONFIG_BSP_DISPLAY_LVGL_AVOID_TEAR=y
CONFIG_BSP_DISPLAY_LVGL_DIRECT_MODE=y
# end of Display

CONFIG_ESP32S3_DATA_CACHE_LINE_64B=y

# Some USB flash drives are slow to enumerate, so you need to turn this variable up.
CONFIG_USB_HOST_RESET_RECOVERY_MS=500
```

## esp32-s3-usb-bridge/examples/usb_wireless_bridge/sdkconfig.defaults
```kconfig
CONFIG_FREERTOS_HZ=1000
CONFIG_ESP_TASK_WDT_CHECK_IDLE_TASK_CPU0=n

CONFIG_WS2812_LED_GPIO=48
```

## esp32-s3-usb-otg/examples/factory/sdkconfig.defaults
```kconfig
CONFIG_TINYUSB=y
CONFIG_TINYUSB_MSC_ENABLED=y
CONFIG_TINYUSB_MSC_BUFSIZE=4096
CONFIG_TINYUSB_HID_ENABLED=y
CONFIG_TINYUSB_HID_BUFSIZE=64
CONFIG_TINYUSB_TASK_PRIORITY=10

CONFIG_TINYUSB_DESC_USE_ESPRESSIF_VID=y
CONFIG_TINYUSB_DESC_USE_DEFAULT_PID=y
CONFIG_TINYUSB_DESC_BCD_DEVICE=0x0100
CONFIG_TINYUSB_DESC_MANUFACTURER_STRING="Espressif Systems"
CONFIG_TINYUSB_DESC_PRODUCT_STRING="ESP32_S3_OTG"
CONFIG_TINYUSB_DESC_SERIAL_STRING="123456"
CONFIG_TINYUSB_DESC_MSC_STRING="Espressif MSC Device"
CONFIG_TINYUSB_DESC_HID_STRING="Espressif HID Device"

CONFIG_PARTITION_TABLE_CUSTOM=y
CONFIG_PARTITION_TABLE_CUSTOM_FILENAME="partitions_example.csv"
CONFIG_PARTITION_TABLE_FILENAME="partitions_example.csv"

CONFIG_ESPTOOLPY_FLASHSIZE_4MB=y
CONFIG_ESPTOOLPY_FLASHSIZE="4MB"

#
# Serial flasher config
#
CONFIG_ESPTOOLPY_BAUD_OTHER_VAL=115200
# CONFIG_ESPTOOLPY_NO_STUB is not set
# CONFIG_ESPTOOLPY_OCT_FLASH is not set
CONFIG_ESPTOOLPY_FLASHMODE_QIO=y
# CONFIG_ESPTOOLPY_FLASHMODE_QOUT is not set
# CONFIG_ESPTOOLPY_FLASHMODE_DIO is not set
# CONFIG_ESPTOOLPY_FLASHMODE_DOUT is not set
CONFIG_ESPTOOLPY_FLASHMODE="dio"
# CONFIG_ESPTOOLPY_FLASHFREQ_120M is not set
CONFIG_ESPTOOLPY_FLASHFREQ_80M=y
# CONFIG_ESPTOOLPY_FLASHFREQ_40M is not set
# CONFIG_ESPTOOLPY_FLASHFREQ_20M is not set
CONFIG_ESPTOOLPY_FLASHFREQ="80m"
# CONFIG_ESPTOOLPY_FLASHSIZE_1MB is not set
# CONFIG_ESPTOOLPY_FLASHSIZE_2MB is not set
CONFIG_ESPTOOLPY_FLASHSIZE_4MB=y
# CONFIG_ESPTOOLPY_FLASHSIZE_8MB is not set
# CONFIG_ESPTOOLPY_FLASHSIZE_16MB is not set
CONFIG_ESPTOOLPY_FLASHSIZE="4MB"
CONFIG_ESPTOOLPY_FLASHSIZE_DETECT=y
CONFIG_ESPTOOLPY_BEFORE_RESET=y
# CONFIG_ESPTOOLPY_BEFORE_NORESET is not set
CONFIG_ESPTOOLPY_BEFORE="default_reset"
CONFIG_ESPTOOLPY_AFTER_RESET=y
# CONFIG_ESPTOOLPY_AFTER_NORESET is not set
CONFIG_ESPTOOLPY_AFTER="hard_reset"
# CONFIG_ESPTOOLPY_MONITOR_BAUD_CONSOLE is not set
# CONFIG_ESPTOOLPY_MONITOR_BAUD_9600B is not set
# CONFIG_ESPTOOLPY_MONITOR_BAUD_57600B is not set
CONFIG_ESPTOOLPY_MONITOR_BAUD_115200B=y
# CONFIG_ESPTOOLPY_MONITOR_BAUD_230400B is not set
# CONFIG_ESPTOOLPY_MONITOR_BAUD_921600B is not set
# CONFIG_ESPTOOLPY_MONITOR_BAUD_2MB is not set
# CONFIG_ESPTOOLPY_MONITOR_BAUD_OTHER is not set
CONFIG_ESPTOOLPY_MONITOR_BAUD_OTHER_VAL=115200
CONFIG_ESPTOOLPY_MONITOR_BAUD=115200
# end of Serial flasher config

#
# Wear Levelling
#
CONFIG_WL_SECTOR_SIZE_512=y
# CONFIG_WL_SECTOR_SIZE_4096 is not set
CONFIG_WL_SECTOR_SIZE=512
# CONFIG_WL_SECTOR_MODE_PERF is not set
CONFIG_WL_SECTOR_MODE_SAFE=y
CONFIG_WL_SECTOR_MODE=1
# end of Wear Levelling

#
# FAT Filesystem support
#
CONFIG_FATFS_CODEPAGE_437=y
CONFIG_FATFS_CODEPAGE=437
CONFIG_FATFS_LFN_HEAP=y
CONFIG_FATFS_MAX_LFN=255
CONFIG_FATFS_API_ENCODING_ANSI_OEM=y
CONFIG_FATFS_FS_LOCK=0
CONFIG_FATFS_TIMEOUT_MS=10000
CONFIG_FATFS_PER_FILE_CACHE=y
# end of FAT Filesystem support

#
# ESP32S2-specific
#
# CONFIG_ESP32S2_DEFAULT_CPU_FREQ_80 is not set
# CONFIG_ESP32S2_DEFAULT_CPU_FREQ_160 is not set
CONFIG_ESP32S2_DEFAULT_CPU_FREQ_240=y
CONFIG_ESP32S2_DEFAULT_CPU_FREQ_MHZ=240

#
# BSP esp32_s3_usb_otg_rv Options
#
CONFIG_BOARD_WIFI_INIT=y
CONFIG_BOARD_SPI3_INIT=y
CONFIG_BOARD_SPI2_INIT=y
CONFIG_BOARD_LCD_INIT=y
CONFIG_BOARD_SD_CARD_INIT=y

#
# Board Wi-Fi Settings
#
CONFIG_BOARD_WIFI_SSID=""
CONFIG_BOARD_WIFI_PASSWORD=""
CONFIG_BOARD_WIFI_AP_SSID="ESP32S3-OTG"
CONFIG_BOARD_WIFI_AP_PASSWORD="12345678"
CONFIG_BOARD_MAX_STA_CONN=3
CONFIG_BOARD_WIFI_AP_CHANNEL=6
CONFIG_BOARD_SERVER_IP="192.168.4.1"
CONFIG_BOARD_MAXIMUM_RETRY=5

CONFIG_LCD_DRIVER_SCREEN_CONTROLLER_ST7789=y

#
# FAT Filesystem support
#
# CONFIG_FATFS_CODEPAGE_DYNAMIC is not set
CONFIG_FATFS_CODEPAGE_437=y
CONFIG_FATFS_CODEPAGE=437
CONFIG_FATFS_LFN_HEAP=y
CONFIG_FATFS_MAX_LFN=255
CONFIG_FATFS_API_ENCODING_ANSI_OEM=y
CONFIG_FATFS_FS_LOCK=0
CONFIG_FATFS_TIMEOUT_MS=10000
CONFIG_FATFS_PER_FILE_CACHE=y

CONFIG_ESP_IPC_TASK_STACK_SIZE=4096
```

## examples/esp-dualkey/components/app_insights/Kconfig
```kconfig
menu "App Insights"
visible if ESP_INSIGHTS_ENABLED

    config APP_INSIGHTS_ENABLE_LOG_TYPE_ALL
        bool "Enable all diagnostics log type"
        default n
        help
            By default only error logs are enabled.
            This config option enables the capture of all log types (errors/warnings/events).

endmenu
```

## examples/esp-dualkey/examples/factory_demo/main/Kconfig.projbuild
```kconfig
menu "ESP KeyBoard Example"

    menu "USB Configuration"
        config TUSB_VID
            hex "USB Device VID"
            default 0x303A
        config TUSB_PID
            hex "USB Device PID"
            default 0x8000
        config TUSB_MANUFACTURER
            string "USB Device Manufacture"
            default "Espressif"
        config TUSB_PRODUCT
            string "Product Name"
            default "HID Demo"
    endmenu

    menu "Wireless Configuration"
        config WS2812_SLEEP_TIMEOUT_S
            int "WS2812 Sleep Timeout"
            default 60
            help
                "Time to enter WS2812 sleep mode and close all light when no key is pressed"
        config DEEP_SLEEP_TIMEOUT_S
            int "Deep Sleep Timeout"
            default 3600
            help
                "Time to enter deep sleep mode"
    endmenu

endmenu
```

## examples/esp32-s2-hmi-devkit-1/examples/get-started/hello_world/sdkconfig.defaults
```kconfig
CONFIG_IDF_TARGET="esp32s2"
CONFIG_BOOTLOADER_LOG_LEVEL_NONE=y
CONFIG_ESPTOOLPY_FLASHSIZE_4MB=y
CONFIG_ESPTOOLPY_MONITOR_BAUD_2MB=y
CONFIG_PARTITION_TABLE_CUSTOM=y
CONFIG_ESP32S2_DEFAULT_CPU_FREQ_240=y
CONFIG_ESP32S2_SPIRAM_SUPPORT=y
CONFIG_SPIRAM_SPEED_80M=y
CONFIG_ESP_CONSOLE_UART_CUSTOM=y
CONFIG_ESP_CONSOLE_UART_BAUDRATE=2000000
CONFIG_ESP_SYSTEM_PANIC_PRINT_HALT=y
CONFIG_FATFS_LFN_HEAP=y
CONFIG_FREERTOS_HZ=1000
```

## examples/esp32-s2-hmi-devkit-1/examples/smart-panel/sdkconfig.defaults
```kconfig
CONFIG_IDF_TARGET="esp32s2"
CONFIG_ESPTOOLPY_FLASHMODE_QIO=y
CONFIG_ESPTOOLPY_FLASHSIZE_4MB=y
CONFIG_ESPTOOLPY_MONITOR_BAUD_2MB=y
CONFIG_PARTITION_TABLE_CUSTOM=y
CONFIG_QCLOUD_MEM_ALLOCATION_SPIRAM=y
CONFIG_ESP_TLS_PSK_VERIFICATION=y
CONFIG_ESP32S2_DEFAULT_CPU_FREQ_240=y
CONFIG_ESP32S2_SPIRAM_SUPPORT=y
CONFIG_SPIRAM_SPEED_80M=y
CONFIG_SPIRAM_MALLOC_ALWAYSINTERNAL=0
CONFIG_SPIRAM_TRY_ALLOCATE_WIFI_LWIP=y
CONFIG_SPIRAM_MALLOC_RESERVE_INTERNAL=0
CONFIG_ESP_CONSOLE_UART_CUSTOM=y
CONFIG_ESP_CONSOLE_UART_BAUDRATE=2000000
CONFIG_ESP_SYSTEM_PANIC_PRINT_HALT=y
CONFIG_ESP32_WIFI_STATIC_RX_BUFFER_NUM=4
CONFIG_ESP32_WIFI_DYNAMIC_RX_BUFFER_NUM=4
CONFIG_ESP32_WIFI_STATIC_TX_BUFFER_NUM=4
CONFIG_ESP32_WIFI_CACHE_TX_BUFFER_NUM=16
CONFIG_ESP32_WIFI_TX_BA_WIN=4
CONFIG_ESP32_WIFI_RX_BA_WIN=4
CONFIG_FATFS_LFN_STACK=y
CONFIG_FREERTOS_HZ=1000
CONFIG_MBEDTLS_DEFAULT_MEM_ALLOC=y
CONFIG_MBEDTLS_SSL_OUT_CONTENT_LEN=8192
```

## examples/esp32-s2-kaluga-1/examples/camera/sdkconfig.defaults
```kconfig
CONFIG_IDF_TARGET="esp32s2"
CONFIG_IDF_TARGET_ESP32S2=y
CONFIG_ESPTOOLPY_FLASHMODE_QIO=y
CONFIG_ESPTOOLPY_FLASHSIZE_4MB=y
CONFIG_CAMERA_JPEG_MODE=y
CONFIG_ESP32S2_DEFAULT_CPU_FREQ_240=y
CONFIG_ESP32S2_SPIRAM_SUPPORT=y
CONFIG_SPIRAM_SPEED_80M=y
# CONFIG_ESP32_WIFI_ENABLE_WPA3_SAE is not set
CONFIG_LWIP_TCP_SYNMAXRTX=6
CONFIG_MBEDTLS_PSK_MODES=y
CONFIG_MBEDTLS_KEY_EXCHANGE_PSK=y
CONFIG_MBEDTLS_SSL_PROTO_DTLS=y
```

## examples/esp32-s2-kaluga-1/examples/lcd/sdkconfig.defaults
```kconfig
CONFIG_IDF_TARGET="esp32s2"
CONFIG_IDF_TARGET_ESP32S2=y
CONFIG_SDK_TOOLPREFIX="xtensa-esp32-elf-"
CONFIG_ESPTOOLPY_FLASHMODE_QIO=y
CONFIG_ESPTOOLPY_FLASHFREQ_40M=y
CONFIG_ESPTOOLPY_FLASHSIZE_4MB=y
CONFIG_PARTITION_TABLE_CUSTOM=y
CONFIG_ESP32S2_SPIRAM_SUPPORT=y
CONFIG_ESP_CONSOLE_UART_TX_GPIO=1
CONFIG_ESP_CONSOLE_UART_RX_GPIO=3
# CONFIG_ESP32_WIFI_ENABLE_WPA3_SAE is not set
CONFIG_LWIP_TCP_SYNMAXRTX=6
CONFIG_MBEDTLS_PSK_MODES=y
CONFIG_MBEDTLS_KEY_EXCHANGE_PSK=y
CONFIG_MBEDTLS_SSL_PROTO_DTLS=y
```

## examples/esp32-s2-kaluga-1/examples/touch/main/Kconfig.projbuild
```kconfig
menu "Example Configuration"
    config EXAMPLE_RMT_TX_GPIO
        int "WS2812 GPIO"
        default 45
        help
            Set the GPIO number used for transmitting the RMT signal.

    config EXAMPLE_STRIP_LED_NUMBER
        int "Number of LEDS in a strip"
        default 1
        help
            A single RGB strip contains several LEDs.
    choice TOUCH_PAD_TYPE
        prompt "touch pad type"
        default TOUCH_PAD_ESP32_S2_KALUGA_V1_3
        config TOUCH_PAD_ESP32_S2_KALUGA_V1_3
            bool "ESP32-S2-KALUGA_V1.3"
        config TOUCH_PAD_ESP32_S2_KALUGA_V1_2
            bool "ESP32-S2-KALUGA_V1.2"
        config TOUCH_PAD_ESP32_S2_KALUGA_V1_1
            bool "ESP32-S2-KALUGA_V1.1"

        help
            Set the GPIO number used for transmitting the RMT signal.
    endchoice
endmenu
```

## examples/esp32-s2-kaluga-1/examples/web_tts/main/Kconfig.projbuild
```kconfig
menu "Example Configuration"

    choice AUDIO_PAD_TYPE
       prompt "audio pad type"
        default AUDIO_PAD_ESP32_S2_KALUGA_V1_2
        config AUDIO_PAD_ESP32_S2_KALUGA_V1_3
            bool "ESP32-S2-KALUGA_V1.3"
        config AUDIO_PAD_ESP32_S2_KALUGA_V1_2
            bool "ESP32-S2-KALUGA_V1.2"
        config AUDIO_PAD_ESP32_S2_KALUGA_V1_1
            bool "ESP32-S2-KALUGA_V1.1"
        help
            Set the GPIO number used for transmitting the RMT signal.
    endchoice
    
menu "WiFi Settings"
config ESP_WIFI_SSID
    string "WiFi STA SSID"
    default ""
    help
    WiFi SSID (network name) to connect to or empty for Off.

config ESP_WIFI_PASSWORD
    string "WiFi STA Password"
    default ""
    help
    WiFi Password if WEP/WPA/WPA2 or empty if Open.
    
config ESP_WIFI_AP_SSID
    string "WiFi AP SSID"
    default "ESP32-Camera"
    help
	AP SSID (network name) to create or empty for Off.

config ESP_WIFI_AP_PASSWORD
    string "WiFi AP Password"
    default ""
    help
	AP password for WPA2 or empty for Open.

config SERVER_IP
    string "WiFi AP IP Address"
    default "192.168.4.1"
    help
        IP address that the ESP will assign to it's AP interface. You can use this IP to connect to the camera after flashing.

config ESP_MAXIMUM_RETRY
    int "Maximum retry"
    default 5
    help
    Set the Maximum retry to avoid station reconnecting to the AP unlimited when the AP is really inexistent.
endmenu


endmenu
```

## examples/esp32-s3-lcd-ev-board/examples/86box_smart_panel/main/Kconfig
```kconfig
menu "QWeather Configuration"
    config QWEATHER_REQUEST_KEY
        string "Request Key"
        default "REQUEST_KEY"
        help
            Set QWeather request key. You can add key at https://console.qweather.com/#/apps.
endmenu
```

## examples/esp32-s3-lcd-ev-board/examples/86box_smart_panel/sdkconfig.defaults
```kconfig
CONFIG_IDF_TARGET="esp32s3"
CONFIG_ESPTOOLPY_FLASHMODE_QIO=y
CONFIG_ESPTOOLPY_FLASHSIZE_16MB=y
CONFIG_PARTITION_TABLE_CUSTOM=y
CONFIG_SR_WN_LOAD_MULIT_WORD=y
CONFIG_SR_WN_WN9_HILEXIN_MULTI=y
CONFIG_SR_WN_WN9_HIESP_MULTI=y
CONFIG_SR_MN_CN_MULTINET5_RECOGNITION_QUANT8=y
CONFIG_SR_MN_EN_MULTINET5_SINGLE_RECOGNITION_QUANT8=y
CONFIG_COMPILER_OPTIMIZATION_PERF=y
CONFIG_ESP_TLS_INSECURE=y
CONFIG_ESP_TLS_SKIP_SERVER_CERT_VERIFY=y
CONFIG_LCD_RGB_RESTART_IN_VSYNC=y
CONFIG_SPIRAM=y
CONFIG_SPIRAM_MODE_OCT=y
CONFIG_SPIRAM_FETCH_INSTRUCTIONS=y
CONFIG_SPIRAM_RODATA=y
CONFIG_SPIRAM_SPEED_80M=y
CONFIG_SPIRAM_MALLOC_ALWAYSINTERNAL=1024
CONFIG_SPIRAM_TRY_ALLOCATE_WIFI_LWIP=y
CONFIG_SPIRAM_MALLOC_RESERVE_INTERNAL=8192
CONFIG_ESP_DEFAULT_CPU_FREQ_MHZ_240=y
CONFIG_ESP32S3_DATA_CACHE_64KB=y
CONFIG_ESP32S3_DATA_CACHE_LINE_64B=y
CONFIG_ESP_MAIN_TASK_AFFINITY_CPU1=y
CONFIG_ESP_IPC_TASK_STACK_SIZE=4096
CONFIG_ESP_WIFI_STATIC_RX_BUFFER_NUM=3
CONFIG_ESP_WIFI_DYNAMIC_RX_BUFFER_NUM=4
CONFIG_ESP_WIFI_STATIC_TX_BUFFER_NUM=4
CONFIG_ESP_WIFI_CACHE_TX_BUFFER_NUM=16
CONFIG_ESP_WIFI_TX_BA_WIN=4
CONFIG_ESP_WIFI_RX_BA_WIN=4
CONFIG_FREERTOS_HZ=1000
CONFIG_BSP_LCD_SUB_BOARD_480_480=y
CONFIG_BSP_LCD_RGB_BUFFER_NUMS=2
CONFIG_BSP_LCD_RGB_BOUNCE_BUFFER_MODE=y
CONFIG_BSP_LCD_RGB_BOUNCE_BUFFER_HEIGHT=20
CONFIG_BSP_DISPLAY_LVGL_TASK_CORE_ID=1
CONFIG_BSP_DISPLAY_LVGL_TASK_STACK_SIZE_KB=6
CONFIG_BSP_DISPLAY_LVGL_AVOID_TEAR=y
CONFIG_BSP_DISPLAY_LVGL_DIRECT_MODE=y
CONFIG_LV_MEM_CUSTOM=y
CONFIG_LV_FONT_MONTSERRAT_36=y
CONFIG_LV_FONT_DEFAULT_MONTSERRAT_16=y
CONFIG_LV_FONT_FMT_TXT_LARGE=y
```

## examples/esp32-s3-lcd-ev-board/examples/usb_camera_lcd/sdkconfig.defaults
```kconfig
CONFIG_IDF_TARGET="esp32s3"
CONFIG_ESPTOOLPY_FLASHMODE_QIO=y
CONFIG_ESPTOOLPY_FLASHSIZE_16MB=y
CONFIG_COMPILER_OPTIMIZATION_PERF=y
CONFIG_SPIRAM=y
CONFIG_SPIRAM_MODE_OCT=y
CONFIG_SPIRAM_FETCH_INSTRUCTIONS=y
CONFIG_SPIRAM_RODATA=y
CONFIG_SPIRAM_SPEED_80M=y
CONFIG_ESP_DEFAULT_CPU_FREQ_MHZ_240=y
CONFIG_ESP32S3_DATA_CACHE_LINE_64B=y
CONFIG_FREERTOS_HZ=1000
CONFIG_ESP_WIFI_AP_CHANNEL="11"
CONFIG_BSP_LCD_RGB_BUFFER_NUMS=2
CONFIG_BSP_LCD_RGB_BOUNCE_BUFFER_MODE=y
```
