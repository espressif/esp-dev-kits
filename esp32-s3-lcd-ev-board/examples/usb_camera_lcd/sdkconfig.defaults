## examples/esp32-s3-usb-bridge/examples/usb_wireless_bridge/main/Kconfig.projbuild
```kconfig
menu "Bridge Configuration"

    menu "USB Setting"
    config BRIDGE_USB_VID
        hex "USB vendor ID"
        default 0x303A

    config BRIDGE_USB_PID
        hex "USB product ID"
        default 0x1002

    config BRIDGE_MANUFACTURER
        string "USB bridge manufacturer"
        default "Espressif Systems Co. Ltd."

    config BRIDGE_PRODUCT_NAME
        string "USB product name"
        default "ESP USB Bridge"

    config BRIDGE_MSC_VOLUME_LABEL
        string "Volume label shown in the MSC disc"
        default "ESPPROG_MSC"
        help
            Volume label shown in the MSC disc. Max lenght is 11 ASCII characters.
    endmenu

    menu "GPIO Setting"
    config BRIDGE_GPIO_BOOT
        int "GPIO pin for the BOOT signal"
        default 9

    config BRIDGE_GPIO_RST
        int "GPIO pin for the RESET signal"
        default 8

    config BRIDGE_GPIO_RXD
        int "GPIO pin for the RxD signal"
        default 40

    config BRIDGE_GPIO_TXD
        int "GPIO pin for the TxD signal"
        default 41

    config BRIDGE_GPIO_TDI
        int "GPIO pin for the target TDI signal"
        default 3

    config BRIDGE_GPIO_TDO
        int "GPIO pin for the target TDO signal"
        default 2

    config BRIDGE_GPIO_TCK
        int "GPIO pin for the target TCK signal"
        default 4

    config BRIDGE_GPIO_TMS
        int "GPIO pin for the target TMS signal"
        default 5

    config BRIDGE_GPIO_SWITCH_BUTTON
        int "GPIO pin for the switch button"
        default 0
    endmenu

    menu "LED Setting"
    config BRIDGE_MODE_WIRED_HUE
        int "Wired mode's ws2812 Hue"
        range 0 360
        default 270
        help
            270 is Purple

    config BRIDGE_MODE_WIRELESS_HOST_HUE
        int "Wireless host mode's ws2812 Hue"
        range 0 360
        default 200
        help
            100 is Blue
    
    config BRIDGE_MODE_WIRELESS_SLAVE_HUE
        int "Wireless slave mode's ws2812 Hue"
        range 0 360
        default 130
        help
            130 is Green

    config BRIDGE_MODE_ERROR_HUE
        int "Error mode's ws2812 Hue"
        range 0 360
        default 360
        help
            360 is Red
    endmenu

    config BRIDGE_SUPPORT_WIRELESS
        bool "Support wireless mode"
        default y
        help
            Enable wireless mode support. If disabled, the wireless mode will can't be used.

endmenu
```

## examples/esp32-s3-usb-bridge/examples/usb_wireless_bridge/sdkconfig.defaults.esp32s3
```kconfig
CONFIG_IDF_TARGET="esp32s3"
CONFIG_ESP32S3_INSTRUCTION_CACHE_16KB=y
CONFIG_ESP32S3_DATA_CACHE_32KB=y
CONFIG_ESP32S3_DEFAULT_CPU_FREQ_240=y
```

## examples/esp32-s3-usb-otg/components/bsp_esp32_s3_usb_otg_ev/Kconfig
```kconfig
menu "BSP esp32_s3_usb_otg_rv Options"

    config BOARD_I2C0_INIT
        bool "init i2c0 during board init"
        default n
        help
            if enable, i2c0 will be initialized with default configuration during board init,
            then, you can use iot_board_get_handle to get the bus handle.
    config BOARD_SPI3_INIT
        bool "init spi3 during board init"
        default y
        help
            if yes, spi3 will be initialized with default configuration during board init,
            then, you can use iot_board_get_handle to get the bus handle.
    config BOARD_SPI2_INIT
        bool "init spi2 during board init"
        default y
        help
            if yes, spi2 will be initialized with default configuration during board init,
            then, you can use iot_board_get_handle to get the bus handle.
    config BOARD_LCD_INIT
        bool "init lcd during board init"
        default n
        help
            if yes, lcd screen will be initialized with default configuration during board init,
            then, you can use iot_board_get_handle to get the handle.

    config BOARD_SD_CARD_INIT
        bool "init SD Card during board init"
        default n
        help
            if yes, SD Card will be initialized with default configuration during board init,
            then, you can use iot_board_get_handle to get the handle.

    menu "Board Wi-Fi Settings"

            config BOARD_WIFI_SSID
                string "WiFi STA SSID"
                default ""
                help
                WiFi SSID (network name) to connect to or empty for Off.
    
            config BOARD_WIFI_PASSWORD
                string "WiFi STA Password"
                default ""
                help
                WiFi Password if WEP/WPA/WPA2 or empty if Open.
    
            config BOARD_WIFI_AP_SSID
                string "WiFi AP SSID"
                default "ESP32S3-OTG"
                help
                AP SSID (network name) to create or empty for Off.
    
            config BOARD_WIFI_AP_PASSWORD
                string "WiFi AP Password"
                default ""
                help
                AP password for WPA2 or empty for Open.
    
            config BOARD_MAX_STA_CONN
                int "WiFi AP Maximal STA connections"
                default 3
                help
                Max number of the STA connects to AP.
    
            config BOARD_WIFI_AP_CHANNEL
                int "WiFi AP Channel"
                default 6
                help
                AP channel for better connection performance.
    
            config BOARD_SERVER_IP
                string "WiFi AP IP Address"
                default "192.168.4.1"
                help
                    IP address that the ESP will assign to it's AP interface. You can use this IP to connect to the camera after flashing.
    
            config BOARD_MAXIMUM_RETRY
                int "Maximum retry"
                default 5
                help
                Set the Maximum retry to avoid station reconnecting to the AP unlimited when the AP is really inexistent.
    endmenu
endmenu
```

## examples/esp32-s3-usb-otg/components/decoder_jpeg_ijg/Kconfig
```kconfig
menu "Decoder JPEG IJG"

    choice OUTPUT_COLOR_SPACE
        prompt "choose jpeg decoder output color space"
        default COLOR_SPACE_RGB_565

        config COLOR_SPACE_RGB_888
            bool "Color Space RGB 888"
        config COLOR_SPACE_RGB_565
            bool "Color Space RGB 565"
    endchoice

endmenu
```
