## esp32-c3-lcd-ev-board/components/bsp/Kconfig
```kconfig
menu "Board Support Package"

    config BSP_ERROR_CHECK
        bool "Enable error check in BSP"
        default y
        help
            Error check assert the application before returning the error code.

    menu "Display"

        config BSP_DISPLAY_BRIGHTNESS_LEDC_CH
        int "LEDC channel index"
        default 1
        range 0 7
        help
            LEDC channel is used to generate PWM signal that controls display brightness.
            Set LEDC index that should be used.
    endmenu

endmenu
```

## esp32-c3-lcdkit/components/bsp/Kconfig
```kconfig
menu "Board Support Package"

    config BSP_ERROR_CHECK
        bool "Enable error check in BSP"
        default y
        help
            Error check assert the application before returning the error code.

    menu "Display"
        config BSP_DISPLAY_BRIGHTNESS_LEDC_CH
        int "LEDC channel index"
        default 1
        range 0 7
        help
            LEDC channel is used to generate PWM signal that controls display brightness.
            Set LEDC index that should be used.
    endmenu

    menu "SPIFFS - Virtual File System"
        config BSP_SPIFFS_FORMAT_ON_MOUNT_FAIL
            bool "Format SPIFFS if mounting fails"
            default n
            help
                Format SPIFFS if it fails to mount the filesystem.

        config BSP_SPIFFS_MOUNT_POINT
            string "SPIFFS mount point"
            default "/spiffs"
            help
                Mount point of SPIFFS in the Virtual File System.

        config BSP_SPIFFS_PARTITION_LABEL
            string "Partition label of SPIFFS"
            default "storage"
            help
                Partition label which stores SPIFFS.

        config BSP_SPIFFS_MAX_FILES
            int "Max files supported for SPIFFS VFS"
            default 5
            help
                Supported max files for SPIFFS in the Virtual File System.
    endmenu

endmenu
```

## esp32-c3-lcdkit/examples/knob_panel/sdkconfig.defaults
```kconfig
CONFIG_IDF_TARGET="esp32c3"
CONFIG_ESPTOOLPY_NO_STUB=y
CONFIG_ESPTOOLPY_FLASHMODE_QIO=y
CONFIG_ESPTOOLPY_FLASHSIZE_4MB=y
CONFIG_PARTITION_TABLE_CUSTOM=y
CONFIG_BT_ENABLED=y
CONFIG_BT_NIMBLE_ENABLED=y
CONFIG_BT_NIMBLE_MAX_CONNECTIONS=1
# CONFIG_BT_NIMBLE_ROLE_CENTRAL is not set
# CONFIG_BT_NIMBLE_ROLE_OBSERVER is not set
CONFIG_BT_NIMBLE_NVS_PERSIST=y
CONFIG_BT_NIMBLE_ACL_BUF_COUNT=20
# CONFIG_ESP_ERR_TO_NAME_LOOKUP is not set
CONFIG_ESP_HTTP_CLIENT_ENABLE_DIGEST_AUTH=y
CONFIG_ESP_IPC_TASK_STACK_SIZE=1536
CONFIG_FREERTOS_HZ=1000
CONFIG_FREERTOS_ENABLE_BACKWARD_COMPATIBILITY=y
CONFIG_FREERTOS_TIMER_TASK_STACK_DEPTH=3120
CONFIG_FREERTOS_GENERATE_RUN_TIME_STATS=y
# CONFIG_LWIP_DHCPS is not set
# CONFIG_LWIP_IPV6 is not set
# CONFIG_LWIP_ICMP is not set
# CONFIG_MQTT_TRANSPORT_WEBSOCKET is not set
# CONFIG_ESP_PROTOCOMM_SUPPORT_SECURITY_VERSION_2 is not set
CONFIG_LV_COLOR_16_SWAP=y
CONFIG_LV_FONT_MONTSERRAT_12=y
CONFIG_LV_FONT_MONTSERRAT_16=y
CONFIG_LV_FONT_MONTSERRAT_18=y
CONFIG_LV_FONT_MONTSERRAT_20=y
CONFIG_LV_FONT_MONTSERRAT_22=y
CONFIG_LV_FONT_MONTSERRAT_24=y
CONFIG_LV_FONT_MONTSERRAT_26=y
CONFIG_LV_FONT_MONTSERRAT_28=y
CONFIG_LV_FONT_MONTSERRAT_30=y
CONFIG_LV_FONT_MONTSERRAT_32=y
CONFIG_LV_FONT_MONTSERRAT_34=y
CONFIG_LV_FONT_MONTSERRAT_36=y
CONFIG_LV_FONT_MONTSERRAT_38=y
CONFIG_LV_FONT_MONTSERRAT_40=y
CONFIG_LV_FONT_MONTSERRAT_42=y
CONFIG_LV_FONT_MONTSERRAT_44=y
CONFIG_LV_FONT_MONTSERRAT_46=y
CONFIG_LV_FONT_MONTSERRAT_48=y
CONFIG_LV_FONT_MONTSERRAT_12_SUBPX=y
CONFIG_LV_FONT_SIMSUN_16_CJK=y
CONFIG_LV_THEME_DEFAULT_DARK=y
```

## esp32-s2-hmi-devkit-1/components/bsp/Kconfig.projbuild
```kconfig
menu "HMI Board Config"

    choice HMI_BOARD
        prompt "HMI board"
        default ESP32_S2_HMI_DEVKIT_V2_BOARD
        help
            Select an HMI board to use with the HMI project
    config ESP32_S2_HMI_DEVKIT_BOARD
        bool "ESP32-S2-HMI-DevKit"
    config ESP32_S2_HMI_DEVKIT_V2_BOARD
        bool "ESP32-S2-HMI-DevKit-V2"
    config HMI_BOARD_CUSTOM
        bool "Custom HMI board"
    endchoice

    choice LCD_INTERFACE
        prompt "Select LCD interface"
        depends on HMI_BOARD_CUSTOM
        default LCD_INTERFACE_I2S
        help
            Select LCD interface of custom board

    config LCD_INTERFACE_I2C
        bool "LCD_INTERFACE_I2C"
    config LCD_INTERFACE_I2S
        bool "LCD_INTERFACE_I2S"
    config LCD_INTERFACE_SPI
        bool "LCD_INTERFACE_SPI"

    endchoice

    menu "I2S LCD GPIO configuration"
        depends on LCD_INTERFACE_I2S

            config LCD_WR_GPIO
                int "LCD WR GPIO"
                range 0 46
                default 34
            config LCD_RS_GPIO
                int "LCD RS GPIO"
                range 0 46
                default 33
            config LCD_D00_GPIO
                int "LCD D00 GPIO"
                range 0 46
                default 16
            config LCD_D01_GPIO
                int "LCD D01 GPIO"
                range 0 46
                default 15
            config LCD_D02_GPIO
                int "LCD D02 GPIO"
                range 0 46
                default 14
            config LCD_D03_GPIO
                int "LCD D03 GPIO"
                range 0 46
                default 13
            config LCD_D04_GPIO
                int "LCD D04 GPIO"
                range 0 46
                default 12
            config LCD_D05_GPIO
                int "LCD D05 GPIO"
                range 0 46
                default 11
            config LCD_D06_GPIO
                int "LCD D06 GPIO"
                range 0 46
                default 10
            config LCD_D07_GPIO
                int "LCD D07 GPIO"
                range 0 46
                default 9
            config LCD_D08_GPIO
                int "LCD D08 GPIO"
                range 0 46
                default 8
            config LCD_D09_GPIO
                int "LCD D09 GPIO"
                range 0 46
                default 7
            config LCD_D10_GPIO
                int "LCD D10 GPIO"
                range 0 46
                default 6
            config LCD_D11_GPIO
                int "LCD D11 GPIO"
                range 0 46
                default 5
            config LCD_D12_GPIO
                int "LCD D12 GPIO"
                range 0 46
                default 4
            config LCD_D13_GPIO
                int "LCD D13 GPIO"
                range 0 46
                default 3
            config LCD_D14_GPIO
                int "LCD D14 GPIO"
                range 0 46
                default 2
            config LCD_D15_GPIO
                int "LCD D15 GPIO"
                range 0 46
                default 1
    endmenu


    menu "I2C GPIO configuration"
        depends on HMI_BOARD_CUSTOM
        config I2C_SCL_GPIO
            int "I2C SCL GPIO"
            range 0 46
            default 36
        config I2C_SDA_GPIO
            int "I2C SDA GPIO"
            range 0 46
            default 35
    endmenu

    menu "SPI GPIO configuration"
        depends on HMI_BOARD_CUSTOM

        config SPI_CS_GPIO
            int "SPI CS GPIO"
            range 0 46
            default 37
        config SPI_MISO_GPIO
            int "SPI MISO GPIO"
            range 0 46
            default 40
        config SPI_MOSI_GPIO
            int "SPI MOSI GPIO"
            range 0 46
            default 38
        config SPI_SCLK_GPIO
            int "SPI SCLK GPIO"
            range 0 46
            default 39
    endmenu

    menu "TWAI GPIO configuration"
        depends on HMI_BOARD_CUSTOM
        config TWAI_TX_GPIO
            int "TWAI TX GPIO"
            range 0 46
            default 41
        config TWAI_RX_GPIO
            int "TWAI RX GPIO"
            range 0 46
            default 42
    endmenu

    menu "Audio HAL"
        choice AUDIO_INTERFACE
            prompt "Default audio output interface"
            default AUDIO_PWM_OUTPUT
            help
                Default audio output interface.
                Can be PWM or DAC, 8 bit resolution.

            config AUDIO_PWM_OUTPUT
                bool "Use PWM as audio output interface"
            config AUDIO_DAC_OUTPUT
                bool "Use DAC as audio output interface"
        endchoice
    endmenu

    menu "LCD Drivers"
        menu "Select Screen Controller"
            config LCD_DRIVER_SCREEN_CONTROLLER_ILI9341
                bool "ILI9341"
                default n
            config LCD_DRIVER_SCREEN_CONTROLLER_ILI9486
                bool "ILI9486"
                default n
            config LCD_DRIVER_SCREEN_CONTROLLER_ILI9806
                bool "ILI9806"
                default n
            config LCD_DRIVER_SCREEN_CONTROLLER_NT35510
                bool "NT35510"
                default n
            config LCD_DRIVER_SCREEN_CONTROLLER_RM68120
                bool "RM68120"
                default y
            config LCD_DRIVER_SCREEN_CONTROLLER_SSD1351
                bool "SSD1351"
                default n
            config LCD_DRIVER_SCREEN_CONTROLLER_SSD1963
                bool "SSD1963"
                default n
            config LCD_DRIVER_SCREEN_CONTROLLER_ST7789
                bool "ST7789"
                default n
            config LCD_DRIVER_SCREEN_CONTROLLER_ST7796
                bool "ST7796"
                default n
            
            config LCD_DRIVER_SCREEN_CONTROLLER_SSD1306
                bool "SSD1306"
                default n
            config LCD_DRIVER_SCREEN_CONTROLLER_SSD1307
                bool "SSD1307"
                default n
            config LCD_DRIVER_SCREEN_CONTROLLER_SSD1322
                bool "SSD1322"
                default n
        endmenu

    endmenu
endmenu
```

## esp32-s2-hmi-devkit-1/examples/audio/audio_record/sdkconfig.defaults
```kconfig
CONFIG_IDF_TARGET="esp32s2"
CONFIG_ESPTOOLPY_FLASHSIZE_4MB=y
CONFIG_ESPTOOLPY_MONITOR_BAUD_2MB=y
CONFIG_AUDIO_DAC_OUTPUT=y
CONFIG_ESP32S2_DEFAULT_CPU_FREQ_240=y
CONFIG_ESP32S2_DATA_CACHE_8KB=y
CONFIG_ESP_CONSOLE_UART_CUSTOM=y
CONFIG_ESP_CONSOLE_UART_BAUDRATE=2000000
CONFIG_ESP_SYSTEM_PANIC_PRINT_HALT=y
CONFIG_ESP32_WIFI_STATIC_TX_BUFFER=y
CONFIG_FREERTOS_HZ=1000
```

## esp32-s2-hmi-devkit-1/examples/get-started/provision/sdkconfig.defaults
```kconfig
CONFIG_IDF_TARGET="esp32s2"
CONFIG_ESPTOOLPY_FLASHSIZE_4MB=y
CONFIG_ESPTOOLPY_MONITOR_BAUD_2MB=y
CONFIG_PARTITION_TABLE_CUSTOM=y
CONFIG_ESP32S2_DEFAULT_CPU_FREQ_240=y
CONFIG_ESP32S2_SPIRAM_SUPPORT=y
CONFIG_SPIRAM_SPEED_80M=y
CONFIG_SPIRAM_MALLOC_ALWAYSINTERNAL=0
CONFIG_SPIRAM_TRY_ALLOCATE_WIFI_LWIP=y
CONFIG_ESP_CONSOLE_UART_CUSTOM=y
CONFIG_ESP_CONSOLE_UART_BAUDRATE=2000000
CONFIG_ESP_SYSTEM_PANIC_PRINT_HALT=y
CONFIG_ESP32_WIFI_STATIC_RX_BUFFER_NUM=8
CONFIG_ESP32_WIFI_STATIC_TX_BUFFER_NUM=4
# CONFIG_ESP32_WIFI_IRAM_OPT is not set
# CONFIG_ESP32_WIFI_RX_IRAM_OPT is not set
CONFIG_FREERTOS_HZ=1000
```

## esp32-s2-hmi-devkit-1/examples/smart-panel/sdkconfig.defaults
```kconfig
CONFIG_IDF_TARGET="esp32s2"
CONFIG_ESPTOOLPY_FLASHMODE_QIO=y
CONFIG_PARTITION_TABLE_CUSTOM=y
CONFIG_PARTITION_TABLE_FILENAME="partitions.csv"
CONFIG_QCLOUD_MEM_ALLOCATION_SPIRAM=y
CONFIG_ESP_TLS_PSK_VERIFICATION=y
CONFIG_ESP32S2_DEFAULT_CPU_FREQ_240=y
CONFIG_ESP32S2_DEFAULT_CPU_FREQ_MHZ=240
CONFIG_ESP32S2_DATA_CACHE_8KB=y
CONFIG_ESP32S2_DATA_CACHE_LINE_32B=y
CONFIG_ESP32S2_SPIRAM_SUPPORT=y
CONFIG_SPIRAM_TYPE_AUTO=y
CONFIG_SPIRAM_SIZE=-1
CONFIG_DEFAULT_PSRAM_CLK_IO=30
CONFIG_DEFAULT_PSRAM_CS_IO=26
CONFIG_SPIRAM_SPEED_80M=y
CONFIG_SPIRAM=y
CONFIG_SPIRAM_BOOT_INIT=y
CONFIG_SPIRAM_USE_MALLOC=y
CONFIG_SPIRAM_MEMTEST=y
CONFIG_SPIRAM_MALLOC_ALWAYSINTERNAL=0
CONFIG_SPIRAM_TRY_ALLOCATE_WIFI_LWIP=y
CONFIG_SPIRAM_MALLOC_RESERVE_INTERNAL=0
CONFIG_ESP_CONSOLE_UART_CUSTOM=y
CONFIG_ESP_CONSOLE_UART_CUSTOM_NUM_0=y
CONFIG_ESP_CONSOLE_UART_TX_GPIO=43
CONFIG_ESP_CONSOLE_UART_RX_GPIO=44
CONFIG_ESP_CONSOLE_UART_BAUDRATE=2000000
CONFIG_ESP_SYSTEM_PANIC_PRINT_HALT=y
CONFIG_ESP32_WIFI_STATIC_RX_BUFFER_NUM=4
CONFIG_ESP32_WIFI_DYNAMIC_RX_BUFFER_NUM=4
CONFIG_ESP32_WIFI_STATIC_TX_BUFFER=y
CONFIG_ESP32_WIFI_TX_BUFFER_TYPE=0
CONFIG_ESP32_WIFI_STATIC_TX_BUFFER_NUM=4
CONFIG_ESP32_WIFI_CACHE_TX_BUFFER_NUM=16
CONFIG_ESP32_WIFI_TX_BA_WIN=4
CONFIG_ESP32_WIFI_RX_BA_WIN=4
CONFIG_FATFS_LFN_STACK=y
CONFIG_FATFS_MAX_LFN=255
CONFIG_FATFS_API_ENCODING_ANSI_OEM=y
CONFIG_FATFS_ALLOC_PREFER_EXTRAM=y
CONFIG_FREERTOS_HZ=1000
CONFIG_MBEDTLS_DEFAULT_MEM_ALLOC=y
CONFIG_MBEDTLS_SSL_OUT_CONTENT_LEN=8192
CONFIG_MBEDTLS_PSK_MODES=y
CONFIG_MBEDTLS_KEY_EXCHANGE_PSK=y
CONFIG_MBEDTLS_KEY_EXCHANGE_DHE_PSK=y
CONFIG_MBEDTLS_KEY_EXCHANGE_ECDHE_PSK=y
CONFIG_MBEDTLS_KEY_EXCHANGE_RSA_PSK=y
CONFIG_ESPTOOLPY_FLASHSIZE_4MB=y
CONFIG_FLASHMODE_QIO=y
CONFIG_MONITOR_BAUD_2MB=y
CONFIG_MONITOR_BAUD=2000000
CONFIG_CONSOLE_UART_CUSTOM=y
CONFIG_CONSOLE_UART_CUSTOM_NUM_0=y
CONFIG_CONSOLE_UART_NUM=0
CONFIG_CONSOLE_UART_TX_GPIO=43
CONFIG_CONSOLE_UART_RX_GPIO=44
CONFIG_CONSOLE_UART_BAUDRATE=2000000
CONFIG_ESP32S2_PANIC_PRINT_HALT=y
```

## esp32-s2-hmi-devkit-1/examples/storage/usb_msc/sdkconfig.defaults
```kconfig
CONFIG_IDF_TARGET="esp32s2"
CONFIG_ESPTOOLPY_FLASHSIZE_4MB=y
CONFIG_ESPTOOLPY_MONITOR_BAUD_2MB=y
CONFIG_PARTITION_TABLE_CUSTOM=y
CONFIG_PARTITION_TABLE_CUSTOM_FILENAME="partitions_example.csv"
CONFIG_ESP32S2_DEFAULT_CPU_FREQ_240=y
CONFIG_ESP_CONSOLE_UART_CUSTOM=y
CONFIG_ESP_CONSOLE_UART_BAUDRATE=2000000
CONFIG_HTTPD_MAX_REQ_HDR_LEN=1024
CONFIG_ESP_SYSTEM_PANIC_PRINT_HALT=y
CONFIG_FATFS_LFN_HEAP=y
CONFIG_FATFS_TIMEOUT_MS=2000
CONFIG_FREERTOS_HZ=1000
CONFIG_USB_ENABLED=y
# CONFIG_USB_DESC_USE_ESPRESSIF_VID is not set
CONFIG_USB_DESC_CUSTOM_VID=0x303A
# CONFIG_USB_DESC_USE_DEFAULT_PID is not set
CONFIG_USB_DESC_CUSTOM_PID=0x3000
CONFIG_USB_DESC_SERIAL_STRING="FFFFFF"
CONFIG_USB_MSC_ENABLED=y
CONFIG_USB_MSC_BUFSIZE=4096
CONFIG_USB_CDC_ENABLED=y
CONFIG_WL_SECTOR_SIZE_512=y
```

## esp32-s2-kaluga-1/examples/adc_button/main/Kconfig.projbuild
```kconfig
menu "Example Configuration"
    config EXAMPLE_RMT_TX_GPIO
        int "WS2812 GPIO"
        default 45
        help
            Set the GPIO number used for transmitting the RMT signal.

    config EXAMPLE_STRIP_LED_NUMBER
        int "Number of LEDS in a strip"
        default 1
        help
            A single RGB strip contains several LEDs.

endmenu
```

## esp32-s2-kaluga-1/examples/camera/main/Kconfig.projbuild
```kconfig
menu "Example Configuration"
  
 choice CAMERA_PAD_TYPE

        prompt "camera pad type"
        default CAMERA_PAD_ESP32_S2_KALUGA_V1_3
        config CAMERA_PAD_ESP32_S2_KALUGA_V1_3
            bool "ESP32-S2-KALUGA_V1.3"
        config CAMERA_PAD_ESP32_S2_KALUGA_V1_2
            bool "ESP32-S2-KALUGA_V1.2"
        config CAMERA_PAD_ESP32_S2_KALUGA_V1_1
            bool "ESP32-S2-KALUGA_V1.1"
    endchoice
    
    choice LCD_PAD_TYPE
       prompt "LCD pad type"
        default LCD_PAD_ESP32_S2_KALUGA_V1_3
        config LCD_PAD_ESP32_S2_KALUGA_V1_3
            bool "ESP32-S2-KALUGA_V1.3"
        config LCD_PAD_ESP32_S2_KALUGA_V1_2
            bool "ESP32-S2-KALUGA_V1.2"
        config LCD_PAD_ESP32_S2_KALUGA_V1_1
            bool "ESP32-S2-KALUGA_V1.1"
    endchoice

    choice LCD_VERSION

        prompt "LCD version"
        default LCD_ST7789
        config LCD_ST7789
            bool "ST7789"
        config LCD_ILI9341
            bool "ILI9341"
        help
            Set LCD version
    endchoice
    
    config  CAMERA_JPEG_MODE
        bool "jpeg mode"
        
endmenu
```
