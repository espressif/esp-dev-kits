## esp32-s2-kaluga-1/examples/lcd/main/Kconfig.projbuild
```kconfig
menu "Example Configuration"
  
    choice LCD_PAD_TYPE
       prompt "LCD pad type"
        default LCD_PAD_ESP32_S2_KALUGA_V1_3
        config LCD_PAD_ESP32_S2_KALUGA_V1_3
            bool "ESP32-S2-KALUGA_V1.3"
        config LCD_PAD_ESP32_S2_KALUGA_V1_2
            bool "ESP32-S2-KALUGA_V1.2"
        config LCD_PAD_ESP32_S2_KALUGA_V1_1
            bool "ESP32-S2-KALUGA_V1.1"
    endchoice

    choice LCD_VERSION

        prompt "LCD version"
        default LCD_ST7789
        config LCD_ST7789
            bool "ST7789"
        config LCD_ILI9341
            bool "ILI9341"
        help
            Set LCD version
    endchoice
        
endmenu
```

## esp32-s2-kaluga-1/examples/touch_audio/main/Kconfig.projbuild
```kconfig
menu "Example Configuration"

config KALUGA_WIFI
    bool "WIFI config"

    config WIFI_SSID
        string "WiFi SSID"
        default "myssid"
        help
            SSID (network name) for the example to connect to.
 depends on KALUGA_WIFI
    config WIFI_PASSWORD
        string "WiFi Password"
        default "mypassword"
        help
            WiFi password (WPA or WPA2) for the example to use.

    depends on KALUGA_WIFI
    config EXAMPLE_RMT_TX_GPIO
        int "WS2812 GPIO"
        default 45
        help
            Set the GPIO number used for transmitting the RMT signal.

    config EXAMPLE_STRIP_LED_NUMBER
        int "Number of LEDS in a strip"
        default 1
        help
            A single RGB strip contains several LEDs.
    choice TOUCH_PAD_TYPE
        prompt "touch pad type"
        default TOUCH_PAD_ESP32_S2_KALUGA_V1_2
        config TOUCH_PAD_ESP32_S2_KALUGA_V1_2
            bool "ESP32-S2-KALUGA_V1.2"
        config TOUCH_PAD_ESP32_S2_KALUGA_V1_1
            bool "ESP32-S2-KALUGA_V1.1"
    endchoice
    
    choice AUDIO_PAD_TYPE
       prompt "audio pad type"
        default AUDIO_PAD_ESP32_S2_KALUGA_V1_2
        config AUDIO_PAD_ESP32_S2_KALUGA_V1_2
            bool "ESP32-S2-KALUGA_V1.2"
        config AUDIO_PAD_ESP32_S2_KALUGA_V1_1
            bool "ESP32-S2-KALUGA_V1.1"
        help
            Set the GPIO number used for transmitting the RMT signal.
    endchoice
endmenu
```

## esp32-s3-lcd-ev-board/components/bsp/Kconfig.projbuild
```kconfig
menu "Board Configuration"

    choice LCD_SUB_BOARD
        prompt "Select LCD Sub Board"
        default LCD_EV_SUB_BOARD2
        help
            Select an sub board for LCD EV mainboard
    config LCD_EV_SUB_BOARD1
        bool "SUB_BOARD1 128x64 & 320x240 screen"
    config LCD_EV_SUB_BOARD2
        bool "SUB_BOARD2 480x480 & 320x480 screen"
    config LCD_EV_SUB_BOARD3
        bool "SUB_BOARD3 800x480 screen"
    endchoice

    choice LCD_SUB_BOARD1_SCREEN
        depends on LCD_EV_SUB_BOARD1
        prompt "Select screen for Sub Board1"
        default LCD_EV_SUB_BOARD1_LCD_320x240
    config LCD_EV_SUB_BOARD1_OLED_128x64
        bool "128x64 0.96' OLED screen"
    config LCD_EV_SUB_BOARD1_LCD_320x240
        bool "320x240 2.4' LCD screen"
    endchoice

    choice LCD_SUB_BOARD2_SCREEN
        depends on LCD_EV_SUB_BOARD2
        prompt "Select screen for Sub Board2"
        default LCD_EV_SUB_BOARD2_LCD_480x480
    config LCD_EV_SUB_BOARD2_LCD_480x480
        bool "480x480 3.95' LCD screen"
    config LCD_EV_SUB_BOARD2_LCD_480x320
        bool "480x320 3.5' LCD screen"
    endchoice

    choice LCD_SUB_BOARD2_SCREEN_DATA_WIDTH
        depends on LCD_EV_SUB_BOARD2_LCD_480x320
        prompt "Select data width for 480x320 3.5' LCD screen"
        default LCD_EV_SUB_BOARD2_LCD_480x320_8BIT
    config LCD_EV_SUB_BOARD2_LCD_480x320_8BIT
        bool "8Bit 8080 interface"
    config LCD_EV_SUB_BOARD2_LCD_480x320_16BIT
        bool "16Bit 8080 interface"
    endchoice

    config LCD_EVB_SCREEN_WIDTH
        int
        default 800 if LCD_EV_SUB_BOARD3
        default 480 if LCD_EV_SUB_BOARD2_LCD_480x480
        default 320 if LCD_EV_SUB_BOARD2_LCD_480x320
        default 240 if LCD_EV_SUB_BOARD1_LCD_320x240
        default 128 if LCD_EV_SUB_BOARD1_OLED_128x64

    config LCD_EVB_SCREEN_HEIGHT
        int
        default 480 if LCD_EV_SUB_BOARD3 || LCD_EV_SUB_BOARD2_LCD_480x480 || LCD_EV_SUB_BOARD2_LCD_480x320
        default 320 if LCD_EV_SUB_BOARD1_LCD_320x240
        default 64 if LCD_EV_SUB_BOARD1_OLED_128x64

    config LCD_EVB_SCREEN_FREQ
        depends on LCD_EV_SUB_BOARD2_LCD_480x480 || LCD_EV_SUB_BOARD3
        int "Frequency of lcd pclk"
        default 18

    config LCD_AVOID_TEAR
        depends on LCD_EV_SUB_BOARD2_LCD_480x480 || LCD_EV_SUB_BOARD3
        bool "Avoid tearing effect"
        default "n"

    choice LCD_LVGL_MODE
        depends on LCD_AVOID_TEAR
        prompt "Select lvgl mode for avoiding tearing"
        default LCD_LVGL_FULL_REFRESH
        config LCD_LVGL_FULL_REFRESH
            bool "full refresh with two frame psram buffer"
        config LCD_LVGL_DIRECT_MODE
            bool "direct mode with two frame psram buffer"
    endchoice

    config LCD_TASK_PRIORITY
        depends on LCD_AVOID_TEAR
        int "Priority of lcd refresh task"
        default 5

    config LCD_TASK_REFRESH_TIME
        depends on LCD_AVOID_TEAR
        int "Screen refresh period(ms)"
        default 10
endmenu
```

## esp32-s3-lcd-ev-board/examples/86box_smart_panel/main/Kconfig
```kconfig
menu "Project Support Package"

    menu "SPIFFS - Virtual File System"
        config BSP_SPIFFS_FORMAT_ON_MOUNT_FAIL
            bool "Format SPIFFS if mounting fails"
            default n
            help
                Format SPIFFS if it fails to mount the filesystem.

        config BSP_SPIFFS_MOUNT_POINT
            string "SPIFFS mount point"
            default "/spiffs"
            help
                Mount point of SPIFFS in the Virtual File System.

        config BSP_SPIFFS_PARTITION_LABEL
            string "Partition label of SPIFFS"
            default "storage"
            help
                Partition label which stores SPIFFS.

        config BSP_SPIFFS_MAX_FILES
            int "Max files supported for SPIFFS VFS"
            default 5
            help
                Supported max files for SPIFFS in the Virtual File System.
    endmenu

endmenu

menu "QWeather Configuration"
    config QWEATHER_REQUEST_KEY
        string "Request Key"
        default "REQUEST_KEY"
        help
            Set QWeather request key. You can add key at https://console.qweather.com/#/apps.

endmenu
```

## esp32-s3-lcd-ev-board/examples/lvgl_demos/sdkconfig.defaults
```kconfig
CONFIG_IDF_TARGET="esp32s3"
CONFIG_ESPTOOLPY_FLASHMODE_QIO=y
CONFIG_ESPTOOLPY_FLASHSIZE_16MB=y
CONFIG_PARTITION_TABLE_CUSTOM=y
CONFIG_COMPILER_OPTIMIZATION_PERF=y
CONFIG_SPIRAM=y
CONFIG_SPIRAM_MODE_OCT=y
CONFIG_SPIRAM_FETCH_INSTRUCTIONS=y
CONFIG_SPIRAM_RODATA=y
CONFIG_SPIRAM_SPEED_80M=y
CONFIG_ESP_DEFAULT_CPU_FREQ_MHZ_240=y
CONFIG_FREERTOS_HZ=1000
CONFIG_LV_MEM_CUSTOM=y
CONFIG_LV_MEMCPY_MEMSET_STD=y
CONFIG_LV_USE_PERF_MONITOR=y
CONFIG_LV_FONT_MONTSERRAT_12=y
CONFIG_LV_FONT_MONTSERRAT_16=y
CONFIG_LV_FONT_MONTSERRAT_26=y
CONFIG_LV_USE_DEMO_WIDGETS=y
CONFIG_LV_USE_DEMO_BENCHMARK=y
CONFIG_LV_USE_DEMO_STRESS=y
CONFIG_LV_USE_DEMO_MUSIC=y
CONFIG_LV_DEMO_MUSIC_AUTO_PLAY=y
```

## esp32-s3-lcd-ev-board/examples/rgb_lcd_camera_demo/components/bsp/Kconfig.projbuild
```kconfig
menu "Bsp Configuration"
    menu "Bsp Camera"
        choice BSP_CAMERA_RESOLUTION
            prompt "Resolution of camera output frame"
            default BSP_CAMERA_RESOLUTION_800_480
            config BSP_CAMERA_RESOLUTION_800_480
                bool "800 x 480"
            config BSP_CAMERA_RESOLUTION_640_480
                bool "640 x 480"
        endchoice

        config BSP_CAMERA_FRAME_INDEX
            int
            default 1 if BSP_CAMERA_RESOLUTION_800_480
            default 2 if BSP_CAMERA_RESOLUTION_640_480

        config BSP_CAMERA_FRAME_WIDTH
            int
            default 800 if BSP_CAMERA_RESOLUTION_800_480
            default 640 if BSP_CAMERA_RESOLUTION_640_480

        config BSP_CAMERA_FRAME_HEIGHT
            int
            default 480 if BSP_CAMERA_RESOLUTION_800_480
            default 480 if BSP_CAMERA_RESOLUTION_640_480

        config BSP_CAMERA_BUFFER_SIZE
            int "Size of three buffers to storage camera output data(KB)"
            default 35

        choice BSP_CAMERA_FRAME_RATE
            prompt "Frame rate of camera output"
            default BSP_CAMERA_FRAME_RATE_15
            config BSP_CAMERA_FRAME_RATE_5
                bool "5"
            config BSP_CAMERA_FRAME_RATE_10
                bool "10"
            config BSP_CAMERA_FRAME_RATE_15
                bool "15"
            config BSP_CAMERA_FRAME_RATE_25
                bool "25"
            config BSP_CAMERA_FRAME_RATE_30
                bool "30"
        endchoice

        config BSP_CAMERA_FRAME_INTERVAL
            int
            default 2000000 if BSP_CAMERA_FRAME_RATE_5
            default 1000000 if BSP_CAMERA_FRAME_RATE_10
            default 666666  if BSP_CAMERA_FRAME_RATE_15
            default 400000  if BSP_CAMERA_FRAME_RATE_25
            default 333333  if BSP_CAMERA_FRAME_RATE_30

        config BSP_CAMERA_LOG
            bool "Enable output log"
            default n
    endmenu
endmenu
```

## esp32-s3-lcd-ev-board/examples/rgb_lcd_camera_demo/sdkconfig.defaults
```kconfig
CONFIG_IDF_TARGET="esp32s3"
CONFIG_ESPTOOLPY_FLASHMODE_QIO=y
CONFIG_ESPTOOLPY_FLASHFREQ_120M=y
CONFIG_ESPTOOLPY_FLASHSIZE_8MB=y
CONFIG_BSP_CAMERA_FRAME_RATE_25=y
CONFIG_COMPILER_OPTIMIZATION_PERF=y
CONFIG_SPIRAM=y
CONFIG_SPIRAM_MODE_OCT=y
CONFIG_SPIRAM_FETCH_INSTRUCTIONS=y
CONFIG_SPIRAM_RODATA=y
CONFIG_SPIRAM_SPEED_120M=y
CONFIG_ESP_DEFAULT_CPU_FREQ_MHZ_240=y
CONFIG_ESP32S3_DATA_CACHE_64KB=y
CONFIG_ESP32S3_DATA_CACHE_LINE_64B=y
CONFIG_ESP_IPC_TASK_STACK_SIZE=4096
CONFIG_FREERTOS_HZ=1000
CONFIG_FREERTOS_GENERATE_RUN_TIME_STATS=y
```

## esp32-s3-lcd-ev-board/examples/smart-panel/main/Kconfig.projbuild
```kconfig
menu "Example Configuration"
    config LIGHT_REBOOT_UNBROKEN_COUNT_RESET
        int "More than this number of continuous uninterrupted restarts triggers a reset of the device"
        range 3 15
        default 5
        help
            Devices without buttons trigger a device reset through continuous restart.

    config LIGHT_DEBUG
        bool "The device will be in debug mode"
        default n
        help
            Debug mode device performance is only used during development.
endmenu

menu "QWeather Configuration"
    config QWEATHER_REQUEST_KEY
        string "Request Key"
        default "REQUEST_KEY"
        help
            Set QWeather request key. You can add key at https://console.qweather.com/#/apps.

endmenu

menu "wifi Configuration"

    config ESP_WIFI_SSID
        string "WiFi SSID"
        default "myssid"
        help
            SSID (network name) for the example to connect to.

    config ESP_WIFI_PASSWORD
        string "WiFi Password"
        default "mypassword"
        help
            WiFi password (WPA or WPA2) for the example to use.

    config ESP_MAXIMUM_RETRY
        int "Maximum retry"
        default 5
        help
            Set the Maximum retry to avoid station reconnecting to the AP unlimited when the AP is really inexistent.

    choice ESP_WIFI_SCAN_AUTH_MODE_THRESHOLD
        prompt "WiFi Scan auth mode threshold"
        default ESP_WIFI_AUTH_OPEN
        help
            The weakest authmode to accept in the scan mode.

        config ESP_WIFI_AUTH_OPEN
            bool "OPEN"
        config ESP_WIFI_AUTH_WEP
            bool "WEP"
        config ESP_WIFI_AUTH_WPA_PSK
            bool "WPA PSK"
        config ESP_WIFI_AUTH_WPA2_PSK
            bool "WPA2 PSK"
        config ESP_WIFI_AUTH_WPA_WPA2_PSK
            bool "WPA/WPA2 PSK"
        config ESP_WIFI_AUTH_WPA3_PSK
            bool "WPA3 PSK"
        config ESP_WIFI_AUTH_WPA2_WPA3_PSK
            bool "WPA2/WPA3 PSK"
        config ESP_WIFI_AUTH_WAPI_PSK
            bool "WAPI PSK"
    endchoice

endmenu
```

## esp32-s3-lcd-ev-board/examples/smart-panel/sdkconfig.defaults
```kconfig
CONFIG_IDF_TARGET="esp32s3"
CONFIG_ESPTOOLPY_FLASHMODE_QIO=y
CONFIG_ESPTOOLPY_FLASHFREQ_120M=y
CONFIG_ESPTOOLPY_FLASHSIZE_16MB=y
CONFIG_PARTITION_TABLE_CUSTOM=y
CONFIG_COMPILER_OPTIMIZATION_PERF=y
CONFIG_ESP32S3_DEFAULT_CPU_FREQ_240=y
CONFIG_ESP32S3_DATA_CACHE_64KB=y
CONFIG_ESP32S3_DATA_CACHE_LINE_64B=y
CONFIG_ESP32S3_SPIRAM_SUPPORT=y
CONFIG_SPIRAM_MODE_OCT=y

CONFIG_SPIRAM_FETCH_INSTRUCTIONS=y
CONFIG_SPIRAM_RODATA=y
CONFIG_SPIRAM_SPEED_120M=y
CONFIG_ESP_IPC_TASK_STACK_SIZE=4096

#CONFIG_ESP_CONSOLE_USB_SERIAL_JTAG=y

CONFIG_FREERTOS_HZ=1000

CONFIG_FATFS_CODEPAGE_936=y
CONFIG_FATFS_LFN_STACK=y

CONFIG_LCD_EV_SUB_BOARD3=y

# Certificate bundle configuration
#CONFIG_MBEDTLS_CERTIFICATE_BUNDLE_DEFAULT_CMN=y
#CONFIG_MBEDTLS_CUSTOM_CERTIFICATE_BUNDLE=y
#CONFIG_MBEDTLS_CUSTOM_CERTIFICATE_BUNDLE_PATH="server_certs/ca_cert.pem"

CONFIG_EXAMPLE_FIRMWARE_UPGRADE_URL="https://192.168.50.245:8070/rgb.bin"
```
