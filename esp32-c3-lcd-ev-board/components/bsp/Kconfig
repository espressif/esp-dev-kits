## esp32-s3-lcd-ev-board/examples/smart_panel/components/esp32_s3_lcd_ev_board/Kconfig
```kconfig
menu "Board Support Package"

    config BSP_ERROR_CHECK
        bool "Enable error check in BSP"
        default y
        help
            Error check assert the application before returning the error code.

    menu "I2C"
        config BSP_I2C_NUM
            int "I2C peripheral index"
            default 1
            range 0 1
            help
                ESP32S3 has two I2C peripherals, pick the one you want to use.

        config BSP_I2C_FAST_MODE
            bool "Enable I2C fast mode"
            default y
            help
                I2C has two speed modes: normal (100kHz) and fast (400kHz).

        config BSP_I2C_CLK_SPEED_HZ
            int
            default 400000 if BSP_I2C_FAST_MODE
            default 100000
    endmenu

    menu "SPIFFS - Virtual File System"
        config BSP_SPIFFS_FORMAT_ON_MOUNT_FAIL
            bool "Format SPIFFS if mounting fails"
            default n
            help
                Format SPIFFS if it fails to mount the filesystem.

        config BSP_SPIFFS_MOUNT_POINT
            string "SPIFFS mount point"
            default "/spiffs"
            help
                Mount point of SPIFFS in the Virtual File System.

        config BSP_SPIFFS_PARTITION_LABEL
            string "Partition label of SPIFFS"
            default "storage"
            help
                Partition label which stores SPIFFS.

        config BSP_SPIFFS_MAX_FILES
            int "Max files supported for SPIFFS VFS"
            default 5
            help
                Supported max files for SPIFFS in the Virtual File System.
    endmenu

    menu "LCD"
        choice BSP_LCD_SUB_BOARD
            prompt "Select Target Sub board"
            default BSP_LCD_SUB_BOARD_NONE
            help
                Select the sub-board of the LCD. If there are no specific requirements for the sub board, please select "Not specifying a sub board".

            config BSP_LCD_SUB_BOARD_NONE
                bool "Not specifying a sub board"
            config BSP_LCD_SUB_BOARD_480_480
                bool "Sub board 2 with 480x480 RGB LCD"
            config BSP_LCD_SUB_BOARD_800_480
                bool "Sub board 3 with 800x480 RGB LCD"
        endchoice

        config BSP_LCD_SUB_BOARD_TYPE
            int
            default 0 if BSP_LCD_SUB_BOARD_NONE
            default 1 if BSP_LCD_SUB_BOARD_480_480
            default 2 if BSP_LCD_SUB_BOARD_800_480

        config BSP_LCD_RGB_BUFFER_NUMS
            int "Set number of frame buffers"
            default 1
            range 1 3
            help
                Let RGB LCD driver create a specified number of frame-size buffers. Only when it is set to multiple can the avoiding tearing be turned on.

        choice BSP_LCD_RGB_REFRESH_MODE
            prompt "Select the refresh mode for RGB LCD"
            default BSP_LCD_RGB_REFRESH_AUTO
            config BSP_LCD_RGB_REFRESH_AUTO
                bool "Auto refresh mode"
                help
                    Refresh the LCD in the most common way.
            config BSP_LCD_RGB_REFRESH_MANUALLY
                bool "Manually refresh mode"
                help
                    Refresh the LCD in a specific task instead of automatically refreshing.
            config BSP_LCD_RGB_BOUNCE_BUFFER_MODE
                bool "Bounce buffer mode"
                help
                    Enable bounce buffer mode can achieve higher PCLK frequency at the cost of higher CPU consumption.
        endchoice

        config BSP_LCD_RGB_REFRESH_TASK_PERIOD
            int "Minimum Period(ms) of LCD refreshing task"
            depends on BSP_LCD_RGB_REFRESH_MANUALLY
            default 10
            help
               This configuration does not necessarily represent the actual refresh cycle of the RGB interface.

        config BSP_LCD_RGB_REFRESH_TASK_PRIORITY
            int "Priority of LCD refreshing task"
            depends on BSP_LCD_RGB_REFRESH_MANUALLY
            default 2

        config BSP_LCD_RGB_BOUNCE_BUFFER_HEIGHT
            depends on BSP_LCD_RGB_BOUNCE_BUFFER_MODE
            int "Bounce buffer height"
            default 10
            help
                Height of bounce buffer. The width of the buffer is the same as that of the LCD.
    endmenu

    menu "Display"
        config BSP_DISPLAY_LVGL_TASK_PRIORITY
            int "LVGL task priority"
            default 2
            help
                The Board Support Package will create a task that will periodically handle LVGL operation in lv_timer_handler().

        config BSP_DISPLAY_LVGL_TASK_CORE_ID
            int "LVGL task pinned core ID"
            default -1
            range -1 1
            help
                Core to pin LVGL task. -1 means no pinning.

        config BSP_DISPLAY_LVGL_TASK_DELAY
            int "LVGL task minimum delay time (ms)"
            default 10
            range 1 100
            help
                Minimum delay time for LVGL task. It should be larger if the task watchdog is triggered frequently.

        config BSP_DISPLAY_LVGL_TASK_STACK_SIZE_KB
            int "LVGL task stack size (KB)"
            default 4
            help
                Size(KB) of LVGL task stack.

        config BSP_DISPLAY_LVGL_TICK
            int "LVGL tick period"
            default 5
            range 1 100
            help
                Period of LVGL tick timer.

        config BSP_DISPLAY_LVGL_AVOID_TEAR
            bool "Avoid tearing effect"
            depends on BSP_LCD_RGB_BUFFER_NUMS > 1
            default "n"
            help
                Avoid tearing effect through LVGL buffer mode and double frame buffers of RGB LCD. This feature is only available for RGB LCD.

        choice BSP_DISPLAY_LVGL_MODE
            depends on BSP_DISPLAY_LVGL_AVOID_TEAR
            prompt "Select LVGL buffer mode"
            default BSP_DISPLAY_LVGL_FULL_REFRESH
            config BSP_DISPLAY_LVGL_FULL_REFRESH
                bool "Full refresh"
            config BSP_DISPLAY_LVGL_DIRECT_MODE
                bool "Direct mode"
        endchoice

        choice BSP_DISPLAY_LVGL_ROTATION
            depends on BSP_DISPLAY_LVGL_AVOID_TEAR
            depends on BSP_LCD_RGB_BUFFER_NUMS = 3
            prompt "Select rotation"
            default BSP_DISPLAY_LVGL_ROTATION_NONE
            config BSP_DISPLAY_LVGL_ROTATION_NONE
                bool "Rotation 0"
            config BSP_DISPLAY_LVGL_ROTATION_90
                bool "Rotation 90"
            config BSP_DISPLAY_LVGL_ROTATION_180
                bool "Rotation 180"
            config BSP_DISPLAY_LVGL_ROTATION_270
                bool "Rotation 270"
            help
                Rotate screen when avoid tearing effect is enabled. Need to set BSP_LCD_RGB_BUFFER_NUMS to 3.
        endchoice

        config BSP_DISPLAY_LVGL_ROTATION_DEGREE
            int
            default 0 if BSP_DISPLAY_LVGL_ROTATION_NONE
            default 1 if BSP_DISPLAY_LVGL_ROTATION_90
            default 2 if BSP_DISPLAY_LVGL_ROTATION_180
            default 3 if BSP_DISPLAY_LVGL_ROTATION_270

        choice BSP_DISPLAY_LVGL_BUF_CAPS
            depends on !BSP_DISPLAY_LVGL_AVOID_TEAR
            prompt "Select LVGL buffer memory capability"
            default BSP_DISPLAY_LVGL_INTERNAL
            config BSP_DISPLAY_LVGL_PSRAM
                bool "PSRAM memory"
            config BSP_DISPLAY_LVGL_INTERNAL
                bool "Internal memory"
        endchoice

        config BSP_DISPLAY_LVGL_BUF_HEIGHT
            depends on !BSP_DISPLAY_LVGL_AVOID_TEAR
            int "LVGL buffer height"
            default 100
            help
                Height of LVGL buffer. The width of the buffer is the same as that of the LCD.
    endmenu

    config BSP_I2S_NUM
        int "I2S peripheral index"
        default 1
        range 0 1
        help
            ESP32S3 has two I2S peripherals, pick the one you want to use.
endmenu
```

## esp32-s3-lcd-ev-board/examples/smart_panel/main/Kconfig.projbuild
```kconfig
menu "Example Configuration"
    config LIGHT_REBOOT_UNBROKEN_COUNT_RESET
        int "More than this number of continuous uninterrupted restarts triggers a reset of the device"
        range 3 15
        default 5
        help
            Devices without buttons trigger a device reset through continuous restart.

    config LIGHT_DEBUG
        bool "The device will be in debug mode"
        default n
        help
            Debug mode device performance is only used during development.
endmenu

menu "QWeather Configuration"
    config QWEATHER_REQUEST_KEY
        string "Request Key"
        default "REQUEST_KEY"
        help
            Set QWeather request key. You can add key at https://console.qweather.com/#/apps.

endmenu

menu "wifi Configuration"

    config ESP_WIFI_SSID
        string "WiFi SSID"
        default "myssid"
        help
            SSID (network name) for the example to connect to.

    config ESP_WIFI_PASSWORD
        string "WiFi Password"
        default "mypassword"
        help
            WiFi password (WPA or WPA2) for the example to use.

    config ESP_MAXIMUM_RETRY
        int "Maximum retry"
        default 5
        help
            Set the Maximum retry to avoid station reconnecting to the AP unlimited when the AP is really inexistent.

    choice ESP_WIFI_SCAN_AUTH_MODE_THRESHOLD
        prompt "WiFi Scan auth mode threshold"
        default ESP_WIFI_AUTH_OPEN
        help
            The weakest authmode to accept in the scan mode.

        config ESP_WIFI_AUTH_OPEN
            bool "OPEN"
        config ESP_WIFI_AUTH_WEP
            bool "WEP"
        config ESP_WIFI_AUTH_WPA_PSK
            bool "WPA PSK"
        config ESP_WIFI_AUTH_WPA2_PSK
            bool "WPA2 PSK"
        config ESP_WIFI_AUTH_WPA_WPA2_PSK
            bool "WPA/WPA2 PSK"
        config ESP_WIFI_AUTH_WPA3_PSK
            bool "WPA3 PSK"
        config ESP_WIFI_AUTH_WPA2_WPA3_PSK
            bool "WPA2/WPA3 PSK"
        config ESP_WIFI_AUTH_WAPI_PSK
            bool "WAPI PSK"
    endchoice

endmenu

menu "SPIFFS - Virtual File System"
        config BSP_SPIFFS_FORMAT_ON_MOUNT_FAIL
            bool "Format SPIFFS if mounting fails"
            default n
            help
                Format SPIFFS if it fails to mount the filesystem.

        config BSP_SPIFFS_MOUNT_POINT
            string "SPIFFS mount point"
            default "/spiffs"
            help
                Mount point of SPIFFS in the Virtual File System.

        config BSP_SPIFFS_PARTITION_LABEL
            string "Partition label of SPIFFS"
            default "storage"
            help
                Partition label which stores SPIFFS.

        config BSP_SPIFFS_MAX_FILES
            int "Max files supported for SPIFFS VFS"
            default 5
            help
                Supported max files for SPIFFS in the Virtual File System.
    endmenu
```

## esp32-s3-lcd-ev-board/examples/smart_panel/sdkconfig.defaults
```kconfig
CONFIG_IDF_TARGET="esp32s3"
CONFIG_ESPTOOLPY_FLASHMODE_QIO=y
CONFIG_ESPTOOLPY_FLASHFREQ_80M=y
CONFIG_ESPTOOLPY_FLASHSIZE_16MB=y
CONFIG_PARTITION_TABLE_CUSTOM=y
CONFIG_SR_WN_WN9_HIESP=y
CONFIG_SR_MN_CN_NONE=y
CONFIG_SR_MN_EN_MULTINET5_SINGLE_RECOGNITION_QUANT8=y
CONFIG_COMPILER_OPTIMIZATION_PERF=y
CONFIG_ESP_TLS_INSECURE=y
CONFIG_ESP_TLS_SKIP_SERVER_CERT_VERIFY=y
CONFIG_LCD_RGB_RESTART_IN_VSYNC=y
CONFIG_ESP_PHY_REDUCE_TX_POWER=y
CONFIG_SPIRAM=y
CONFIG_SPIRAM_MODE_OCT=y
CONFIG_SPIRAM_FETCH_INSTRUCTIONS=y
CONFIG_SPIRAM_RODATA=y
CONFIG_SPIRAM_SPEED_80M=y
CONFIG_SPIRAM_MALLOC_ALWAYSINTERNAL=1024
CONFIG_SPIRAM_TRY_ALLOCATE_WIFI_LWIP=y
CONFIG_SPIRAM_MALLOC_RESERVE_INTERNAL=8192
CONFIG_SPIRAM_ALLOW_BSS_SEG_EXTERNAL_MEMORY=y
CONFIG_ESP_DEFAULT_CPU_FREQ_MHZ_240=y
CONFIG_ESP32S3_DATA_CACHE_64KB=y
CONFIG_ESP32S3_DATA_CACHE_LINE_64B=y
CONFIG_ESP_IPC_TASK_STACK_SIZE=4096
# CONFIG_ESP_WIFI_STA_DISCONNECTED_PM_ENABLE is not set
CONFIG_ESP_WIFI_STATIC_RX_BUFFER_NUM=3
CONFIG_ESP_WIFI_DYNAMIC_RX_BUFFER_NUM=4
CONFIG_ESP_WIFI_STATIC_TX_BUFFER_NUM=4
CONFIG_ESP_WIFI_CACHE_TX_BUFFER_NUM=16
CONFIG_ESP_WIFI_TX_BA_WIN=4
CONFIG_ESP_WIFI_RX_BA_WIN=4
CONFIG_FATFS_LFN_STACK=y
CONFIG_FATFS_CODEPAGE_936=y
CONFIG_FREERTOS_HZ=1000
CONFIG_WIFI_PROV_BLE_FORCE_ENCRYPTION=y
CONFIG_BSP_LCD_SUB_BOARD_800_480=y
CONFIG_BSP_LCD_RGB_BOUNCE_BUFFER_MODE=y
CONFIG_BSP_DISPLAY_LVGL_TASK_STACK_SIZE_KB=6
CONFIG_BSP_DISPLAY_LVGL_PSRAM=y
CONFIG_LV_MEM_CUSTOM=y
CONFIG_LV_MEMCPY_MEMSET_STD=y
CONFIG_LV_USE_USER_DATA=y
CONFIG_LV_FONT_MONTSERRAT_32=y
CONFIG_LV_FONT_MONTSERRAT_40=y
CONFIG_LV_THEME_DEFAULT_COLOR_PRIMARY=0x00
```
