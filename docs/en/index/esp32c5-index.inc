.. toctree::
    :hidden:
    :caption: {IDF_TARGET_NAME} Boards

    ESP32-C5-DevKitC-1 <esp32-c5-devkitc-1/index>
    ESP-SensairShuttle <esp-sensairshuttle/index>


============================   ===========================
      **{IDF_TARGET_NAME} Development Boards**
----------------------------------------------------------
|ESP32-C5-DevKitC-1|_            |ESP-SensairShuttle|_
----------------------------   ---------------------------
`ESP32-C5-DevKitC-1`_            `ESP-SensairShuttle`_
============================   ===========================

.. |ESP32-C5-DevKitC-1| image:: ../_static/esp32-c5-devkitc-1/esp32-c5-devkitc-1-isometric_v1.1.png
.. _ESP32-C5-DevKitC-1: esp32-c5-devkitc-1/index.html

.. |ESP-SensairShuttle| image:: ../_static/esp-sensairshuttle/esp-sensairshuttle-board-isometric-v1_0.png
                        :height: 240px
                        :width: 400px
.. _ESP-SensairShuttle: esp-sensairshuttle/index.html
