.. toctree::
    :hidden:
    :caption: {IDF_TARGET_NAME} Boards

    ESP32-C6-DevKitC-1 <esp32-c6-devkitc-1/index>
    ESP32-C6-DevKitM-1 <esp32-c6-devkitm-1/index>


============================   ===========================
      **{IDF_TARGET_NAME} Development Boards**
----------------------------------------------------------
|ESP32-C6-DevKitC-1|_          |ESP32-C6-DevKitM-1|_
----------------------------   ---------------------------
`ESP32-C6-DevKitC-1`_          `ESP32-C6-DevKitM-1`_
============================   ===========================

.. |ESP32-C6-DevKitC-1| image:: ../_static/esp32-c6-devkitc-1/esp32-c6-devkitc-1-isometric_v1.2.png
.. _ESP32-C6-DevKitC-1: esp32-c6-devkitc-1/index.html

.. |ESP32-C6-DevKitM-1| image:: ../_static/esp32-c6-devkitm-1/esp32-c6-devkitm-1-isometric.png
.. _ESP32-C6-DevKitM-1: esp32-c6-devkitm-1/index.html
