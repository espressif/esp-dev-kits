.. toctree::
    :hidden:
    :caption: {IDF_TARGET_NAME} Boards

    ESP32-S2-DevKitC-1 <esp32-s2-devkitc-1/index>
    ESP32-S2-DevKitM-1 <esp32-s2-devkitm-1/index>
    EOL (End of Life) Boards <eol/eol-boards>


============================   ===========================
      **{IDF_TARGET_NAME} Development Boards**
----------------------------------------------------------
|ESP32-S2-DevKitC-1|_            |ESP32-S2-DevKitM-1|_
----------------------------   ---------------------------
`ESP32-S2-DevKitC-1`_            `ESP32-S2-DevKitM-1`_
============================   ===========================

.. |ESP32-S2-DevKitC-1| image:: ../_static/esp32-s2-devkitc-1/esp32-s2-devkitc-1-v1-isometric.png
.. _ESP32-S2-DevKitC-1: esp32-s2-devkitc-1/index.html

.. |ESP32-S2-DevKitM-1| image:: ../_static/esp32-s2-devkitm-1/esp32-s2-devkitm-1-v1-isometric.png
.. _ESP32-S2-DevKitM-1: esp32-s2-devkitm-1/index.html

