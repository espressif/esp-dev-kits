.. toctree::
    :hidden:
    :caption: {IDF_TARGET_NAME} Boards

    ESP32-C3-DevKitC-02 <esp32-c3-devkitc-02/index>
    ESP32-C3-DevKitM-1 <esp32-c3-devkitm-1/index>
    ESP32-C3-LCDkit <esp32-c3-lcdkit/index>


============================   ===========================
      **{IDF_TARGET_NAME} Development Boards**
----------------------------------------------------------
|ESP32-C3-DevKitC-02|_         |ESP32-C3-DevKitM-1|_
----------------------------   ---------------------------
`ESP32-C3-DevKitC-02`_          `ESP32-C3-DevKitM-1`_
----------------------------   ---------------------------
|ESP32-C3-LCDkit|_
----------------------------   ---------------------------
`ESP32-C3-LCDkit`_
============================   ===========================

.. |ESP32-C3-DevKitC-02| image:: ../_static/esp32-c3-devkitc-02/esp32-c3-devkitc-02-v1-isometric.png
.. _ESP32-C3-DevKitC-02: esp32-c3-devkitc-02/index.html

.. |ESP32-C3-DevKitM-1| image:: ../_static/esp32-c3-devkitm-1/esp32-c3-devkitm-1-v1-isometric.png
.. _ESP32-C3-DevKitM-1: esp32-c3-devkitm-1/index.html

.. |ESP32-C3-LCDkit| image:: ../_static/esp32-c3-lcdkit/esp32-c3-lcdkit-isometric-raw.png
.. _ESP32-C3-LCDkit: esp32-c3-lcdkit/index.html
