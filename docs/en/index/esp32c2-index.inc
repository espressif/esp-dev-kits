.. toctree::
    :hidden:
    :caption: {IDF_TARGET_NAME} Boards

    ESP8684-DevKitM-1 <esp8684-devkitm-1/index>
    ESP8684-DevKitC-02 <esp8684-devkitc-02/index>


============================   ===========================
      **{IDF_TARGET_NAME} Development Boards**
----------------------------------------------------------
|ESP8684-DevKitM-1|_            |ESP8684-DevKitC-02|_
----------------------------   ---------------------------
`ESP8684-DevKitM-1`_            `ESP8684-DevKitC-02`_
============================   ===========================

.. |ESP8684-DevKitM-1| image:: ../_static/esp8684-devkitm-1/esp8684-devkitm-1-v1.1-isometric.png
.. _ESP8684-DevKitM-1: esp8684-devkitm-1/index.html

.. |ESP8684-DevKitC-02| image:: ../_static/esp8684-devkitc-02/esp8684-devkitc-02-v1.0-isometric.png
.. _ESP8684-DevKitC-02: esp8684-devkitc-02/index.html
