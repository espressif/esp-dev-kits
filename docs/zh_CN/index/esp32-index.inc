.. toctree::
    :hidden:
    :caption: {IDF_TARGET_NAME} 系列开发板

    ESP32-DevKitC <esp32-devkitc/index>
    ESP32-DevKitM-1 <esp32-devkitm-1/index>
    ESP32-PICO-KIT-1 <esp32-pico-kit-1/index>
    ESP32-PICO-DevKitM-2 <esp32-pico-devkitm-2/index>
    ESP32-LCDKit <esp32-lcdkit/index>
    ESP32-Ethernet-Kit <esp32-ethernet-kit/index>
    寿命终止开发板 <eol/eol-boards>


============================   ===========================
      **{IDF_TARGET_NAME} 系列开发板**
----------------------------------------------------------
|ESP32-DevKitC|_                |ESP32-DevKitM-1|_
----------------------------   ---------------------------
`ESP32-DevKitC`_                `ESP32-DevKitM-1`_
----------------------------   ---------------------------
|ESP32-PICO-KIT-1|_             |ESP32-PICO-DevKitM-2|_
----------------------------   ---------------------------
`ESP32-PICO-KIT-1`_             `ESP32-PICO-DevKitM-2`_
----------------------------   ---------------------------
|ESP32-LCDKit|_                 |ESP32-Ethernet-Kit|_
----------------------------   ---------------------------
`ESP32-LCDKit`_                 `ESP32-Ethernet-Kit`_
============================   ===========================

.. |ESP32-LCDKit| image:: ../_static/esp32-lcdkit/esp32-lcdkit-board.png
                  :height: 230px
                  :width: 400px
.. _ESP32-LCDKit: esp32-lcdkit/index.html

.. |ESP32-DevKitC| image:: ../_static/esp32-devkitc/esp32-devkitc-board.png
                  :height: 230px
                  :width: 400px
.. _ESP32-DevKitC: esp32-devkitc/index.html

.. |ESP32-PICO-DevKitM-2| image:: ../_static/esp32-pico-devkitm-2/esp32-pico-devkitm-2-overview.png
.. _ESP32-PICO-DevKitM-2: esp32-pico-devkitm-2/index.html

.. |ESP32-Ethernet-Kit| image:: ../_static/esp32-ethernet-kit/esp32-ethernet-kit-v1.2-overview.png
.. _ESP32-Ethernet-Kit: esp32-ethernet-kit/index.html

.. |ESP32-PICO-KIT-1| image:: ../_static/esp32-pico-kit-1/esp32-pico-kit-1-overview.png
.. _ESP32-PICO-KIT-1: esp32-pico-kit-1/index.html

.. |ESP32-DevKitM-1| image:: ../_static/esp32-devkitm-1/esp32-DevKitM-1-isometric.png
.. _ESP32-DevKitM-1: esp32-devkitm-1/index.html
