.. toctree::
    :hidden:
    :caption: {IDF_TARGET_NAME} 系列开发板

    ESP32-P4-Function-EV-Board <esp32-p4-function-ev-board/index>
    ESP32-P4-EYE <esp32-p4-eye/index>

.. list-table:: **ESP32-P4 系列开发板**
   :header-rows: 0
   :widths: 50 50

   * - |ESP32-P4-Function-EV-Board|_
     - |ESP32-P4-EYE|_
   * - `ESP32-P4-Function-EV-Board`_
     - `ESP32-P4-EYE`_

.. |ESP32-P4-Function-EV-Board| image:: ../_static/esp32-p4-function-ev-board/esp32-p4-function-ev-board-isometric_v1.5.2.png
.. _ESP32-P4-Function-EV-Board: esp32-p4-function-ev-board/index.html

.. |ESP32-P4-EYE| image:: ../_static/esp32-p4-eye/pic_product_esp32_p4_eye_back.png
.. _ESP32-P4-EYE: esp32-p4-eye/index.html
