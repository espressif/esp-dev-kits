.. toctree::
    :hidden:
    :caption: {IDF_TARGET_NAME} 系列开发板

    ESP32-S3-DevKitC-1 <esp32-s3-devkitc-1/index>
    ESP32-S3-DevKitM-1 <esp32-s3-devkitm-1/index>
    ESP32-S3-USB-OTG <esp32-s3-usb-otg/index>
    ESP32-S3-LCD-EV-Board <esp32-s3-lcd-ev-board/index>
    EchoEar <echoear/index>
    ESP-DualKey <esp-dualkey/index>
    寿命终止开发板 <eol/eol-boards>


============================   ===========================
      **{IDF_TARGET_NAME} 系列开发板**
----------------------------------------------------------
|ESP32-S3-DevKitC-1|_            |ESP32-S3-DevKitM-1|_
----------------------------   ---------------------------
`ESP32-S3-DevKitC-1`_            `ESP32-S3-DevKitM-1`_
----------------------------   ---------------------------
|ESP32-S3-USB-OTG|_            |ESP32-S3-LCD-EV-Board|_
----------------------------   ---------------------------
`ESP32-S3-USB-OTG`_            `ESP32-S3-LCD-EV-Board`_
----------------------------   ---------------------------
|EchoEar|_                      |ESP-DualKey|_
----------------------------   ---------------------------  
`EchoEar`_                      `ESP-DualKey`_  
============================   ===========================

.. |ESP32-S3-DevKitC-1| image:: ../_static/esp32-s3-devkitc-1/esp32-s3-devkitc-1-v1-isometric.png
.. _ESP32-S3-DevKitC-1: esp32-s3-devkitc-1/index.html

.. |ESP32-S3-DevKitM-1| image:: ../_static/esp32-s3-devkitm-1/esp32-s3-devkitm-1-v1-isometric.png
.. _ESP32-S3-DevKitM-1: esp32-s3-devkitm-1/index.html

.. |ESP32-S3-USB-OTG| image:: ../_static/esp32-s3-usb-otg/pic_product_esp32_s3_otg.png
                        :height: 230px
                        :width: 400px
.. _ESP32-S3-USB-OTG: esp32-s3-usb-otg/index.html

.. |ESP32-S3-LCD-EV-Board| image:: ../_static/esp32-s3-lcd-ev-board/ESP32-S3-LCD-EV-Board_480x480.png
.. _ESP32-S3-LCD-EV-Board: esp32-s3-lcd-ev-board/index.html

.. |EchoEar| image:: ../_static/echoear/echoear-black-front_v1.0.png
                        :height: 260px
                        :width: 400px
.. _EchoEar: echoear/index.html

.. |ESP-DualKey| image:: ../_static/esp-dualkey/esp-dualkey-front.jpg
                        :height: 260px
                        :width: 400px
.. _ESP-DualKey: esp-dualkey/index.html